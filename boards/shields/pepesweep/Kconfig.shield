## boards/shields/pepesweep/Kconfig.shield
```kconfig
# Copyright (c) 2020 The ZMK Contributors
# SPDX-License-Identifier: MIT

config SHIELD_PEPESWEEP_LEFT
	def_bool $(shields_list_contains,pepesweep_left)

config SHIELD_PEPESWEEP_RIGHT
	def_bool $(shields_list_contains,pepesweep_right)
```

## config/boards/shields/pepesweep/Kconfig.defconfig
```kconfig
# Copyright (c) 2020 The ZMK Contributors
# SPDX-License-Identifier: MIT

# config ZMK_BLE
# 	default y


if SHIELD_PEPESWEEP_LEFT

config ZMK_KEYBOARD_NAME
	default "Pepesweep"

config ZMK_SPLIT_ROLE_CENTRAL
	default y

endif


if SHIELD_PEPESWEEP_LEFT || SHIELD_PEPESWEEP_RIGHT

config ZMK_SPLIT
	default y

endif
```
